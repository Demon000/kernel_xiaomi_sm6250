## coretech/Kconfig
```kconfig
config AIGOV
	default y
	bool "A governor which using ai predicted info as input"
```

## drivers/input/fingerprint/Kconfig
```kconfig
menu "Fingerprint Drivers"

config FINGERPRINT_FPC1020
	tristate "fpc fpc1020 fingerprint drvier support"
	help
	  say y here to enable fpc fingerprint driver support!  

config FINGERPRINT_GF3208
	tristate "Goodix gf3208 fingerprint driver support"
	help
	  say y here to enable gf3208 fingerprint driver support!

endmenu
```
